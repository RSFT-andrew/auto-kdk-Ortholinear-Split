## boards/sheilds/ortholinear_spl/Kconfig.shield
```kconfig
config SHIELD_ORTHOLINEAR_SPL_LEFT
    def_bool $(shields_list_contains,ortholinear_spl_left)
config SHIELD_ORTHOLINEAR_SPL_RIGHT
    def_bool $(shields_list_contains,ortholinear_spl_right)
```

## boards/shields/ortholinear_spl/Kconfig.defconfig
```kconfig
if SHIELD_ORTHOLINEAR_SPL_RIGHT

config ZMK_KEYBOARD_NAME
    default "ortholinear_spl"

endif

if SHIELD_ORTHOLINEAR_SPL_LEFT || SHIELD_ORTHOLINEAR_SPL_RIGHT

config ZMK_SPLIT
    default y

endif
```
